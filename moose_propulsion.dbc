VERSION "Moose propulsion control CAN database"

NS_ :

BS_:

BU_: DCU MCU PCU

BO_ 18 LMSD_MCU: 4 MCU
 SG_ Distance : 7|16@0+ (1,0) [0|65535] "cm" PCU
 SG_ Speed : 23|16@0- (1,0) [-32768|32767] "cm/s" PCU

CM_ BO_ 18 "MCU lidar measurement sent to the PCU. Standard frame ID 0x12. Payload uses a 16-bit distance followed by a 16-bit signed speed, both big-endian. Positive speed means range is decreasing (target approaching the MCU lidar).";
CM_ BU_ DCU "Driver command unit. Add DCU frame definitions when their message IDs and signal layouts are specified.";
CM_ BU_ MCU "Measuring control unit lidar and CAN sender.";
CM_ BU_ PCU "Propulsion control unit CAN receiver and motor controller.";
